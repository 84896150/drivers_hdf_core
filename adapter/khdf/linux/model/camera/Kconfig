## adapter/khdf/linux/model/camera/Kconfig
```kconfig
config DRIVERS_HDF_CAMERA
    bool "Enable HDF Camera driver"
    default n
    depends on DRIVERS_HDF
    help
        Answer Y to choice HDF Camera driver.
```

## model/input/driver/touchscreen/Kconfig
```kconfig
config ARCH_NXP_TOUCH
    bool "config nxp ft5x06 touch"
        default n
    help
      Answer Y to enable config ft5x06 touch.
```
